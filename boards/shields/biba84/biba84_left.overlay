#include "biba84.dtsi"

&kscan0 {
    col-gpios
        =  <&gpio1 6  (GPIO_ACTIVE_HIGH | GPIO_PULL_DOWN)>,  
             <&gpio1 4  (GPIO_ACTIVE_HIGH | GPIO_PULL_DOWN)>,  
             <&gpio0 11 (GPIO_ACTIVE_HIGH | GPIO_PULL_DOWN)>,
             <&gpio1 0  (GPIO_ACTIVE_HIGH | GPIO_PULL_DOWN)>,  
             <&gpio0 24 (GPIO_ACTIVE_HIGH | GPIO_PULL_DOWN)>, 
             <&gpio0 22 (GPIO_ACTIVE_HIGH | GPIO_PULL_DOWN)>,  
             <&gpio0 20 (GPIO_ACTIVE_HIGH | GPIO_PULL_DOWN)>;
};

