## boards/shields/Lilac84/Kconfig.defconfig
```kconfig
if SHIELD_LILAC84_RIGHT

# Name must be less than 16 characters long!
config ZMK_KEYBOARD_NAME
    default "Lilac84"

config ZMK_SPLIT_ROLE_CENTRAL
    default y

endif

if SHIELD_LILAC84_LEFT || SHIELD_LILAC84_RIGHT

config ZMK_SPLIT
    default y

endif

# Force-enable Mouse Emulation and HID Mouse Reports
CONFIG_ZMK_POINTING=y
CONFIG_ZMK_HID_REPORT_MOUSE=y
CONFIG_ZMK_MOUSE=y
CONFIG_ZMK_HID_REPORT_KEYBOARD=y
CONFIG_ZMK_HID_BOOT_PROTOCOL=y
```

## boards/shields/Lilac84/Kconfig.shield
```kconfig
# No whitespace after the comma or in your part name!
config SHIELD_LILAC84_LEFT
    def_bool $(shields_list_contains,LILAC84_left)

# No whitespace after the comma or in your part name!
config SHIELD_LILAC84_RIGHT
    def_bool $(shields_list_contains,LILAC84_right)

CONFIG_ZMK_SOFT_OFF=y
```

## boards/shields/biba84/Kconfig.defconfig
```kconfig
if SHIELD_BIBA84_LEFT

# Name must be less than 16 characters long!
config ZMK_KEYBOARD_NAME
    default "biba84"

config ZMK_SPLIT_ROLE_CENTRAL
    default y

endif

if SHIELD_BIBA84_LEFT || SHIELD_BIBA84_RIGHT

config ZMK_SPLIT
    default y

endif

# Force-enable Mouse Emulation and HID Mouse Reports
CONFIG_ZMK_POINTING=y
CONFIG_ZMK_HID_REPORT_MOUSE=y
CONFIG_ZMK_MOUSE=y
CONFIG_ZMK_HID_REPORT_KEYBOARD=y
CONFIG_ZMK_HID_BOOT_PROTOCOL=y
```

## boards/shields/biba84/Kconfig.shield
```kconfig
# No whitespace after the comma or in your part name!
config SHIELD_BIBA84_LEFT
    def_bool $(shields_list_contains,biba84_left)

# No whitespace after the comma or in your part name!
config SHIELD_BIBA84_RIGHT
    def_bool $(shields_list_contains,biba84_right)

CONFIG_ZMK_SOFT_OFF=y
```
